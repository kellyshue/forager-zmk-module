## config/west.yml
```yaml
manifest:
  remotes:
  - name: zmkfirmware
    url-base: https://github.com/zmkfirmware
  - name: caksoylar
    url-base: https://github.com/caksoylar
  projects:
  - name: zmk
    remote: zmkfirmware
    revision: v0.3.0
    import: app/west.yml
  - name: zmk-rgbled-widget
    url: https://github.com/caksoylar/zmk-rgbled-widget
    revision: c12cf5cb28e44809d9f07e895ffcf10c0026d3dd
    path: modules/zmk-rgbled-widget
  self:
    path: config
```
